#include "Sweep.dtsi"


&kscan0 {
    col-gpios
          =  <&gpio1 0 GPIO_ACTIVE_HIGH>,
             <&gpio0 11 GPIO_ACTIVE_HIGH>,
             <&gpio1 4 GPIO_ACTIVE_HIGH>,
             <&gpio1 6  GPIO_ACTIVE_HIGH>,  
             <&gpio0 9 GPIO_ACTIVE_HIGH>
            ;
};

&encoder_left {
    status = "okay";
};


